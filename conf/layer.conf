## conf/layer.conf
```bitbake
BBPATH .= ":${LAYERDIR}"
BBFILES += "${LAYERDIR}/recipes-*/*/*.bb \
            ${LAYERDIR}/recipes-*/*/*.bbappend"

BBFILE_COLLECTIONS += "ambiorix-demo"
BBFILE_PATTERN_ambiorix-demo = "^${LAYERDIR}/"
BBFILE_PRIORITY_ambiorix-demo = "10"

LICENSE_PATH += "${LAYERDIR}/licenses"

LAYERDEPENDS_ambiorix-demo = "core meta-oe"
LAYERSERIES_COMPAT_ambiorix-demo = "scarthgap"
```
